## config/boards/shields/corne/Kconfig.shield
```kconfig
config SHIELD_CORNE_LEFT
    def_bool $(shields_list_contains,CORNE_left)

config SHIELD_CORNE_RIGHT
    def_bool $(shields_list_contains,CORNE_right)

config SHIELD_CORNE_DONGLE
	def_bool $(shields_list_contains,CORNE_dongle)
```
